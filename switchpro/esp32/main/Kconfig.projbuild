## switchpro/esp32/main/Kconfig.projbuild
```kconfig
menu "Switch Pro bridge"
    config SP_UART_TX
        int "UART TX GPIO to CH582 RX"
        range 0 33
        default 17
    config SP_UART_RX
        int "UART RX GPIO from CH582 TX"
        range 0 39
        default 16
    config SP_BUTTON_LABELS
        bool "Map Nintendo A/B/X/Y labels instead of Xbox physical positions"
        default n
endmenu
```

## switchpro/esp32/sdkconfig.defaults
```kconfig
CONFIG_COMPILER_OPTIMIZATION_PERF=y
CONFIG_ESPTOOLPY_FLASHSIZE_4MB=y
CONFIG_ESP_MAIN_TASK_STACK_SIZE=8192
CONFIG_BT_ENABLED=y
CONFIG_BT_CONTROLLER_ONLY=y
CONFIG_BTDM_CTRL_MODE_BTDM=y
CONFIG_BTDM_CTRL_BR_EDR_MAX_ACL_CONN=2
CONFIG_BTDM_CTRL_BLE_MAX_CONN=1
CONFIG_BTDM_CTRL_BR_EDR_MAX_SYNC_CONN=0
CONFIG_BTDM_CTRL_MODEM_SLEEP=n
CONFIG_BLUEPAD32_PLATFORM_CUSTOM=y
CONFIG_BLUEPAD32_MAX_DEVICES=1
CONFIG_BLUEPAD32_MAX_ALLOWLIST=1
CONFIG_BLUEPAD32_GAP_SECURITY=y
CONFIG_BLUEPAD32_USB_CONSOLE_ENABLE=n
CONFIG_BLUEPAD32_ENABLE_BLE_BY_DEFAULT=n
CONFIG_BTSTACK_AUDIO=n
CONFIG_SP_UART_TX=17
CONFIG_SP_UART_RX=16
CONFIG_SP_BUTTON_LABELS=n
```
